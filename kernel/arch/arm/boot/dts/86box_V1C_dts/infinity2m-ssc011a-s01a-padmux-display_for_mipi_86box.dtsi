/*
* infinity2m-ssc011a-s01a-padmux-display_for_mipi.dtsi- Sigmastar
*
* Copyright (c) [2019~2020] SigmaStar Technology.
*
*
* This software is licensed under the terms of the GNU General Public
* License version 2, as published by the Free Software Foundation, and
* may be copied, distributed, and modified under those terms.
*
* This program is distributed in the hope that it will be useful,
* but WITHOUT ANY WARRANTY; without even the implied warranty of
* MERCHANTABILITY or FITNESS FOR A PARTICULAR PURPOSE.  See the
* GNU General Public License version 2 for more details.
*
*/

#include <../../../../drivers/sstar/include/infinity2m/padmux.h>
#include <../../../../drivers/sstar/include/mdrv_puse.h>

/ {
    soc {
         padmux {
            compatible = "sstar-padmux";
            schematic =
                <PAD_GPIO13         PINMUX_FOR_GPIO_MODE        MDRV_PUSE_NA >,
                <PAD_GPIO6      PINMUX_FOR_I2C0_MODE_4          MDRV_PUSE_I2C0_SCL >,
                <PAD_GPIO7      PINMUX_FOR_I2C0_MODE_4          MDRV_PUSE_I2C0_SDA >,
                <PAD_GPIO8      PINMUX_FOR_UART2_MODE_2         MDRV_PUSE_UART2_RX>,
                <PAD_GPIO9      PINMUX_FOR_UART2_MODE_2         MDRV_PUSE_UART2_TX>,
                <PAD_TTL21         PINMUX_FOR_GPIO_MODE        MDRV_PUSE_I2C1_DEV_RESET >,
                <PAD_TTL20         PINMUX_FOR_GPIO_MODE        MDRV_PUSE_I2C1_DEV_IRQ >,
                //<PAD_GPIO14  >,
                <PAD_FUART_RX        PINMUX_FOR_FUART_MODE_2  MDRV_PUSE_FUART_RX>,
                <PAD_FUART_TX        PINMUX_FOR_FUART_MODE_2  MDRV_PUSE_FUART_TX>,
                //<PAD_FUART_CTS       PINMUX_FOR_FUART_MODE_1 MDRV_PUSE_FUART_CTS>,
                //<PAD_FUART_RTS       PINMUX_FOR_FUART_MODE_1 MDRV_PUSE_FUART_RTS>,
                //<PAD_TTL0         PINMUX_FOR_SDIO_MODE_1      MDRV_PUSE_SDIO0_PWR >,
                <PAD_TTL6            PINMUX_FOR_TX_MIPI_MODE_1  MDRV_PUSE_TX_MIPI_P_CH0 >,
                <PAD_TTL7            PINMUX_FOR_TX_MIPI_MODE_1  MDRV_PUSE_TX_MIPI_N_CH0>,
                <PAD_TTL8            PINMUX_FOR_TX_MIPI_MODE_1  MDRV_PUSE_TX_MIPI_P_CH1>,
                <PAD_TTL9            PINMUX_FOR_TX_MIPI_MODE_1  MDRV_PUSE_TX_MIPI_N_CH1 >,
                <PAD_TTL10           PINMUX_FOR_TX_MIPI_MODE_1  MDRV_PUSE_TX_MIPI_P_CH2 >,
                <PAD_TTL11           PINMUX_FOR_TX_MIPI_MODE_1  MDRV_PUSE_TX_MIPI_N_CH2 >,
                <PAD_TTL12           PINMUX_FOR_TX_MIPI_MODE_1  MDRV_PUSE_TX_MIPI_P_CH3 >,
                <PAD_TTL13           PINMUX_FOR_TX_MIPI_MODE_1  MDRV_PUSE_TX_MIPI_N_CH3 >,
                <PAD_TTL14           PINMUX_FOR_TX_MIPI_MODE_1  MDRV_PUSE_TX_MIPI_P_CH4 >,
                <PAD_TTL15           PINMUX_FOR_TX_MIPI_MODE_1  MDRV_PUSE_TX_MIPI_N_CH4 >,
                <PAD_TTL16           PINMUX_FOR_GPIO_MODE       MDRV_PUSE_TTL_DOUT15 >,
                <PAD_UART0_RX        PINMUX_FOR_GPIO_MODE       MDRV_PUSE_UART0_RX >,
                <PAD_UART0_TX        PINMUX_FOR_UART0_MODE_1    MDRV_PUSE_UART0_TX >,
                <PAD_UART1_RX        PINMUX_FOR_UART1_MODE_1    MDRV_PUSE_UART1_RX >,
                <PAD_UART1_TX        PINMUX_FOR_UART1_MODE_1    MDRV_PUSE_UART1_TX >,
                <PAD_SD_CLK            PINMUX_FOR_SDIO_MODE_1       MDRV_PUSE_SDIO0_CLK >,
                <PAD_SD_CMD            PINMUX_FOR_SDIO_MODE_1       MDRV_PUSE_SDIO0_CMD >,
                <PAD_SD_D0            PINMUX_FOR_SDIO_MODE_1       MDRV_PUSE_SDIO0_D0 >,
                <PAD_SD_D1              PINMUX_FOR_SDIO_MODE_1      MDRV_PUSE_SDIO0_D1>,
                <PAD_SD_D2              PINMUX_FOR_SDIO_MODE_1      MDRV_PUSE_SDIO0_D2>,
                <PAD_SD_D3            PINMUX_FOR_SDIO_MODE_1      MDRV_PUSE_SDIO0_D3>,
                <PAD_PM_SD_CDZ          PINMUX_FOR_SDIO_MODE_1      MDRV_PUSE_SDIO0_CDZ>,

                <PAD_PM_IRIN            PINMUX_FOR_PM_IRIN_MODE     MDRV_PUSE_IR>,  // IR: default non-GPIO
                <PAD_SAR_GPIO0          PINMUX_FOR_SAR_MODE     MDRV_PUSE_SAR_GPIO0 >, // sar: default not-GPIO,
                <PAD_DM_P1              PINMUX_FOR_USB_MODE     MDRV_PUSE_UTMI1_DM >,  // utmi: default not-GPIO
                <PAD_DP_P1              PINMUX_FOR_USB_MODE     MDRV_PUSE_UTMI1_DP >,  // utmi: default not-GPIO
                <PAD_DM_P2              PINMUX_FOR_USB_MODE     MDRV_PUSE_UTMI2_DM >,  // utmi: default not-GPIO
                <PAD_DP_P2              PINMUX_FOR_USB_MODE     MDRV_PUSE_UTMI2_DP >,  // utmi: default not-GPIO
                <PAD_HDMITX_SCL PINMUX_FOR_DMIC_MODE_2 MDRV_PUSE_DMIC_D1 >,
                <PAD_HDMITX_SDA PINMUX_FOR_DMIC_MODE_2 MDRV_PUSE_DMIC_D0 >,
                <PAD_HDMITX_HPD PINMUX_FOR_DMIC_MODE_2 MDRV_PUSE_DMIC_CLK >;

            status = "ok"; // ok or disable
            //status = "disable";
        };

    };

};
